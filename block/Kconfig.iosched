## block/Kconfig.iosched
```kconfig
if BLOCK

menu "IO Schedulers"

config IOSCHED_SIO
	tristate "Simple I/O scheduler"
	default y
	---help---
	  The Simple I/O scheduler is an extremely simple scheduler that
	  does basic merging and no sorting. It is aimed for usage in
	  aleatory access devices like SSD, USB flash devices, etc.
	  It differences synchronous requests from asynchronous ones for
	  better interactibility.

config IOSCHED_CFQ
	tristate "CFQ I/O scheduler"
	# If BLK_CGROUP is a module, CFQ has to be built as module.
	depends on (BLK_CGROUP=m && m) || !BLK_CGROUP || BLK_CGROUP=y
	default y
	---help---
	  The CFQ I/O scheduler tries to distribute bandwidth equally
	  among all processes in the system. It should provide a fair
	  and low latency working environment, suitable for both desktop
	  and server systems.

	  This is the default I/O scheduler.

	  Note: If BLK_CGROUP=m, then CFQ can be built only as module.

config CFQ_GROUP_IOSCHED
	bool "CFQ Group Scheduling support"
	depends on IOSCHED_CFQ && BLK_CGROUP
	default n
	---help---
	  Enable group IO scheduling in CFQ.

choice
	prompt "Default I/O scheduler"
	default DEFAULT_SIO
	help
	  Select the I/O scheduler which will be used by default for all
	  block devices.

	config DEFAULT_CFQ
		bool "CFQ" if IOSCHED_CFQ=y

	config DEFAULT_SIO
		bool "SIO" if IOSCHED_SIO=y

endchoice

config DEFAULT_IOSCHED
	string
	default "cfq" if DEFAULT_CFQ
	default "sio" if DEFAULT_SIO

endmenu

endif
```
